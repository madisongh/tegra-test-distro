## layers/meta-tegra-support/conf/layer.conf
```bitbake
BBPATH =. "${LAYERDIR}:"
BBFILES += "${LAYERDIR}/recipes-*/*/*.bb ${LAYERDIR}/recipes-*/*/*.bbappend"

BBFILE_COLLECTIONS += "tegrasupport"
BBFILE_PATTERN_tegrasupport = "^${LAYERDIR}/"
BBFILE_PRIORITY_tegrasupport = "40"

BBFILES_DYNAMIC += "\
    rauc:${LAYERDIR}/dynamic-layers/meta-rauc/recipes*/*/*.bb \
    rauc:${LAYERDIR}/dynamic-layers/meta-rauc/recipes*/*/*.bbappend \
    swupdate:${LAYERDIR}/dynamic-layers/meta-swupdate/recipes*/*/*.bb \
    swupdate:${LAYERDIR}/dynamic-layers/meta-swupdate/recipes*/*/*.bbappend \
"

LAYERVERSION_tegrasupport = "4"
LAYERDEPENDS_tegrasupport = "core tegra"
LAYERSERIES_COMPAT_tegrasupport = "dunfell"
```

## layers/meta-testdistro/conf/distro/testdistro-mender.conf
```bitbake
include testdistro.conf

REQUIRED_TD_BBLAYERS_CONF_VERSION = "${DISTRO}-3"

DISTRO = "testdistro-mender"
DISTRO_NAME = "Test Distro with Mender"
DISTRO_CODENAME .= "+mender"

# The distro version doesn't include DATE to avoid basehash changes in do_image_mender
DISTRO_VERSION = "${DISTRO_VERSION_BASE}+snapshot"

# For use in the /etc/os-release rewriter in
# mender-workarounds.bbclass
OS_RELEASE_VERSION ?= "${BUILDNAME} (${DISTRO_CODENAME})"

### Additions for mender ###
# distro_layer_buildinfo added to provide git hash in BUILDNAME
# (and thus MENDER_ARTIFACT_NAME)
INHERIT += "mender-full distro_layer_buildinfo"
INHERIT_append_tegra = " tegra-mender-setup mender-workarounds mendersign"
# DISTRO_LAYER defaults to "meta-${DISTRO}", which is not correct here.
DISTRO_LAYER = "meta-testdistro"

BUILDNAME ?= "${@d.getVar('DISTRO_VERSION').replace('+snapshot','')}${DISTRO_LAYER_BUILDTAG}"
BUILDNAME[vardepvalue] = "${DISTRO_VERSION}"

MENDER_ARTIFACT_NAME ?= "${IMAGE_BASENAME}_${BUILDNAME}"

TEGRA_IMAGE_FSTYPES = "tegraflash mender dataimg"
TEGRA_IMAGE_FSTYPES_cryptparts = "tar.gz mender dataimg"
IMAGE_FSTYPES_tegra = "${TEGRA_IMAGE_FSTYPES}"
IMAGE_FSTYPES_pn-tegra-minimal-initramfs_tegra = "${INITRAMFS_FSTYPES}"

MENDER_STORAGE_DEVICE_BASE ?= "/dev/mmcblk0p"

IMAGE_INSTALL_append_tegra = " tegra-eeprom-tool i2c-tools tegra-bup-payload"

# 5046 = 950 (default from above) plus 4096 for the swap partition
TEGRA_FLASH_PARTITIONS_MB_jetson-nano-2gb-devkit = "5046"
MENDER_DATA_PART_NUMBER_jetson-nano-devkit = "3"
MENDER_ROOTFS_PART_B_NUMBER_jetson-nano-devkit = "2"
# Swap is in partition 3 on the 2GB devkit
MENDER_DATA_PART_NUMBER_jetson-nano-2gb-devkit = "4"
MENDER_ROOTFS_PART_B_NUMBER_jetson-nano-2gb-devkit = "2"
# Overrides until meta-mender-tegra is updated
BOOTENV_SIZE_jetson-nano-devkit = "0x8000"
BOOTENV_SIZE_jetson-nano-2gb-devkit = "0x8000"

# Required for handling downgrades to versions that still use
# the NVIDIA stock bootloader tools, which use the nvbootctrl
# command in downloaded ArtifactInstall scripts.
IMAGE_INSTALL_append_tegra = " tegra-boot-tools-nvbootctrl"

MENDER_FEATURES_ENABLE_remove_cryptparts = "mender-growfs-data"

KERNEL_ARGS_append = " loglevel=3"
KERNEL_ARGS_remove = "console=tty0"

# Machine-specific overrides for "semi-stateless" setup:
#   - enable systemd volatile root in 'overlay' mode,
#     with systemd in the initramfs (via td-initramfs)
#   - expect UDA (/data) partition to be 16MB
#   - additional partitions:
#       - LOGS (for /var/log), fixed size
#       - EXTRA (for /var/extra), last partition in eMMC
#   - overlay mounts for /var/lib and /home are placed on
#     /var/extra, as is the Docker storage area.
MACHINEOVERRIDES_prepend_tegra = "semi-stateless:"
KERNEL_ARGS_append_tegra_semi-stateless = " systemd.volatile=overlay"
INITRAMFS_IMAGE_semi-stateless = "td-initramfs"
# Default to 4GiB rootfs part size for 16GiB units
ROOTFSPART_SIZE_tegra_semi-stateless = "4294967296"
# Use 8GiB for 32GiB units
ROOTFSPART_SIZE_jetson-xavier_semi-stateless = "8589934592"
ROOTFSPART_SIZE_jetson-tx2_semi-stateless = "8589934592"

MENDER_FEATURES_ENABLE_remove_semi-stateless = "mender-growfs-data"
MENDER_DATA_PART_SIZE_MB_DEFAULT_semi-stateless = "16"

# Disable run-postinsts
ROOTFS_BOOTSTRAP_INSTALL_semi-stateless = ""
```

## layers/meta-testdistro/conf/distro/testdistro.conf
```bitbake
DISTRO = "testdistro"
DISTRO_NAME = "Test Distro"
DISTRO_VERSION_BASE = "3.1.3"
DISTRO_VERSION = "${DISTRO_VERSION_BASE}+snapshot-${DATE}"
DISTRO_CODENAME = "dunfell-l4t-r32.5.0"
SDK_VENDOR = "-tdsdk"
SDK_VERSION := "${@'${DISTRO_VERSION}'.replace('snapshot-${DATE}','snapshot')}"

MAINTAINER = "OE4Tegra team <oe4tegra@madison.systems>"

TARGET_VENDOR = "-oe4t"

# New ${DISTRO}-<version> setting for sanity checks.
# Increment version number (and the corresponding
# setting int the template bblayers.conf.sample file)
# each time the layer settings are changed.
REQUIRED_TD_BBLAYERS_CONF_VERSION = "${DISTRO}-3"

LOCALCONF_VERSION = "1"

DISTRO_VERSION[vardepsexclude] = "DATE"
SDK_VERSION[vardepsexclude] = "DATE"

TD_DEFAULT_DISTRO_FEATURES = "largefile opengl ptest multiarch wayland vulkan systemd pam virtualization"

DISTRO_FEATURES ?= "${DISTRO_FEATURES_DEFAULT} ${TD_DEFAULT_DISTRO_FEATURES}"

# Jetson platforms do not use linux-yocto, but for QEMU testing
# align with the poky distro.
PREFERRED_VERSION_linux-yocto ?= "5.4%"

# Use keystore TA
PREFERRED_PROVIDER_virtual/secure-os_tegra186 = "tos-keystore"
PREFERRED_PROVIDER_virtual/secure-os_tegra194 = "tos-keystore"

# Gstreamer libraries are passed through to containers when using
# nvidia-docker, so our version of Gstreamer must match the one in
# the stock L4T/JetPack release.
require conf/include/gstreamer-1.14.conf

SDK_NAME = "${DISTRO}-${TCLIBC}-${SDKMACHINE}-${IMAGE_BASENAME}-${TUNE_PKGARCH}-${MACHINE}"
SDKPATH = "/opt/${DISTRO}/${SDK_VERSION}"

TCLIBCAPPEND = ""

PREMIRRORS ??= "\
bzr://.*/.*   http://downloads.yoctoproject.org/mirror/sources/ \n \
cvs://.*/.*   http://downloads.yoctoproject.org/mirror/sources/ \n \
git://.*/.*   http://downloads.yoctoproject.org/mirror/sources/ \n \
gitsm://.*/.* http://downloads.yoctoproject.org/mirror/sources/ \n \
hg://.*/.*    http://downloads.yoctoproject.org/mirror/sources/ \n \
osc://.*/.*   http://downloads.yoctoproject.org/mirror/sources/ \n \
p4://.*/.*    http://downloads.yoctoproject.org/mirror/sources/ \n \
svn://.*/.*   http://downloads.yoctoproject.org/mirror/sources/ \n"

SANITY_TESTED_DISTROS ?= " \
            ubuntu-18.04 \n \
            ubuntu-20.04 \n \
            ubuntu-20.10 \n \
            "

# CUDA 10.2 requires gcc 7 or 8
GCCVERSION_aarch64 = "8.%"
SDKGCCVERSION = "9.%"

# Most NVIDIA-supplied services expect systemd
INIT_MANAGER = "systemd"

INHERIT += "tegra-support-sanity"

require conf/distro/include/no-static-libs.inc
require conf/distro/include/yocto-uninative.inc
require conf/distro/include/security_flags.inc
INHERIT += "uninative"

INHERIT += "reproducible_build"

LICENSE_FLAGS_WHITELIST += "commercial_faad2"

IMAGE_CLASSES_append_tegra = " tegrasign image_extras"

# No syslog in these builds, using systemd-journald directly.
# On platforms with a /var/log partition, logs will persist
VOLATILE_LOG_DIR = "no"
VIRTUAL-RUNTIME_base-utils-syslog = ""
# No /var/volatile hackery in these builds - not needed
FILESYSTEM_PERMS_TABLES = "files/fs-perms-no-volatile.txt"
# Ensure that the initramfs and main rootfs use the same UIDs/GIDs.
# This is important if using systemd in the initramfs.
USERADDEXTENSION = "useradd-staticids"
USERADD_ERROR_DYNAMIC = "error"
IMGCLASSES_append = " rootfs-postcommands-overrides"
```

## layers/meta-testdistro/conf/layer.conf
```bitbake
BBPATH =. "${LAYERDIR}:"
BBFILES += "${LAYERDIR}/recipes-*/*/*.bb ${LAYERDIR}/recipes-*/*/*.bbappend"

BBFILE_COLLECTIONS += "testdistro"
BBFILE_PATTERN_testdistro = "^${LAYERDIR}/"
BBFILE_PRIORITY_testdistro = "50"

LAYERVERSION_testdistro = "4"
LAYERSERIES_COMPAT_testdistro = "hardknott"

# This is used by the tegra-distro-sanity bbclass
# to identify the distro layer directory during
# bblayers checks.
TD_DISTRO_LAYERDIR = "${LAYERDIR}"
```

## layers/meta-testdistro/conf/machine/jetson-agx-xavier-devkit.conf
```bitbake
#@TYPE: Machine
#@NAME: Nvidia Jetson Xavier
#@DESCRIPTION: Nvidia Jetson Xavier dev board

require conf/machine/include/tegra194.inc

KERNEL_DEVICETREE ?= "_ddot_/_ddot_/_ddot_/_ddot_/nvidia/platform/t19x/galen/kernel-dts/tegra194-p2888-0001-p2822-0000.dtb"
KERNEL_ARGS ?= "console=ttyTCU0,115200 fbcon=map:0 loglevel=3"

EMMC_SIZE ?= "31276924928"
EMMC_DEVSECT_SIZE ?= "512"
BOOTPART_SIZE ?= "8388608"
BOOTPART_LIMIT ?= "10485760"
ROOTFSPART_SIZE ?= "644250944"
ODMDATA ?= "0x9190000"
EMMC_BCT ?= "tegra194-mb1-bct-memcfg-p2888.cfg"
EMMC_BCT_OVERRIDE ?= "tegra194-memcfg-sw-override.cfg"
NVIDIA_BOARD ?= "t186ref"
PARTITION_LAYOUT_TEMPLATE ?= "flash_${MACHINE}_custom.xml"
INITRAMFS_IMAGE = "td-initramfs"
MACHINE_EXTRA_RDEPENDS += "tegra-boot-tools-lateboot lvm2-udevrules"
IMAGE_FSTYPES = "tar.gz ext4.gz tegraflash"
```

## layers/meta-testdistro/conf/machine/jetson-nano-devkit-sb.conf
```bitbake
MACHINEOVERRIDES = "jetson-nano-devkit:secureboot:${MACHINE}"
INITRAMFS_IMAGE ?= "td-initramfs"
KERNEL_ARGS ?= "fbcon=map:0 net.ifnames=0 loglevel=3"
require conf/machine/jetson-nano-devkit.conf
PACKAGE_EXTRA_ARCHS_append = " jetson-nano-devkit"
PARTITION_LAYOUT_TEMPLATE = "flash_${MACHINE}_custom.xml"
```

## layers/meta-testdistro/conf/machine/jetson-nano-qspi-sd-sb.conf
```bitbake
MACHINEOVERRIDES = "jetson-nano-qspi-sd:secureboot:${MACHINE}"
INITRAMFS_IMAGE ?= "td-initramfs"
KERNEL_ARGS ?= "console=ttyS0,115200 console=tty0 fbcon=map:0 net.ifnames=0 loglevel=3"
require conf/machine/jetson-nano-qspi-sd.conf
PACKAGE_EXTRA_ARCHS_append = " jetson-nano-qspi-sd"
```

## layers/meta-testdistro/conf/machine/jetson-tx2-sb.conf
```bitbake
MACHINEOVERRIDES = "jetson-tx2-devkit:secureboot:cryptparts:${MACHINE}"
INITRAMFS_IMAGE ?= "td-initramfs"
IMAGE_FSTYPES = "tar.gz"
# This is the FAB for the one TX2 that has been secured - no need to
# supply signed copies for any others.
TEGRA_BUPGEN_SPECS ?= "fab=B00"
TEGRA_FAB ?= "B00"
require conf/machine/jetson-tx2-devkit.conf
PACKAGE_EXTRA_ARCHS_append = " jetson-tx2-devkit"
PREFERRED_PROVIDER_virtual/bootloader = "cboot-t18x"
PREFERRED_PROVIDER_cboot = "cboot-t18x"
PARTITION_LAYOUT_TEMPLATE = "flash_${MACHINE}_custom.xml"
ROOTFSPART_SIZE_jetson-tx2-sb = "6442450944"
MACHINE_EXTRA_RDEPENDS += "tegra-boot-tools-lateboot lvm2-udevrules"
CORE_IMAGE_EXTRA_INSTALL_append = " ${@'systemd-conf-prod' if d.getVar('INIT_MANAGER') == 'systemd' else ''}"
KERNEL_ARGS = "console=ttyS0,115200 fbcon=map:0 isolcpus=1,2 loglevel=3 rootflags=rw"
```

## layers/meta-testdistro/conf/machine/jetson-tx2.conf
```bitbake
#@TYPE: Machine
#@NAME: Nvidia Jetson TX2
#@DESCRIPTION: Nvidia Jetson TX2 dev board

require conf/machine/include/tegra186.inc

MACHINE_EXTRA_RRECOMMENDS += "tegra-firmware-brcm kernel-module-bcmdhd kernel-module-ov5693"

KERNEL_DEVICETREE ?= "_ddot_/_ddot_/_ddot_/_ddot_/nvidia/platform/t18x/quill/kernel-dts/tegra186-quill-p3310-1000-c03-00-base.dtb"

MACHINE_FEATURES += "wifi bluetooth"

UBOOT_MACHINE = "p2771-0000-500_defconfig"

EMMC_SIZE ?= "31276924928"
EMMC_DEVSECT_SIZE ?= "512"
BOOTPART_SIZE ?= "8388608"
BOOTPART_LIMIT ?= "10485760"
ROOTFSPART_SIZE ?= "30064771072"
ODMDATA ?= "0x1090000"
EMMC_BCT ?= "P3310_A00_8GB_lpddr4_A02_l4t.cfg"
NVIDIA_BOARD ?= "t186ref"
PARTITION_LAYOUT_TEMPLATE ?= "flash_l4t_t186.xml"
ROOTFSPART_SIZE_jetson-tx2 = "6442450944"

TEGRA_FAB ?= "C04"
TEGRA_BOARDID ?= "3310"
TEGRA_BOARDSKU ?= ""
TEGRA_BOARDREV ?= ""
TEGRA_CHIPREV ?= "0"
# Extracted from l4t_generate_soc_bup.sh for BOARDID=3310 and board=jetson-tx2
TEGRA_BUPGEN_SPECS ?= "fab=B00 fab=B02 fab=C04 fab=D00 fab=D01 fab=D02"

INITRAMFS_IMAGE = "td-initramfs"
PREFERRED_PROVIDER_virtual/bootloader = "cboot-t18x"
PREFERRED_PROVIDER_cboot = "cboot-t18x"
PARTITION_LAYOUT_TEMPLATE = "flash_${MACHINE}_custom.xml"
MACHINE_EXTRA_RDEPENDS += "tegra-boot-tools-lateboot lvm2-udevrules"
KERNEL_ARGS = "console=ttyS0,115200 fbcon=map:0 isolcpus=1,2 loglevel=3 rootflags=rw"
IMAGE_FSTYPES = "tar.gz tegraflash"
```

## layers/meta-testdistro/conf/machine/jetson-xavier-nx-sb.conf
```bitbake
#@TYPE: Machine
#@NAME: Nvidia Jetson Xavier NX dev kit (eMMC) with secureboot
#@DESCRIPTION: Nvidia Jetson Xavier NX development kit with QSPI+eMMC
#              module with secureboot enabled
INITRAMFS_IMAGE ?= "td-initramfs"
IMAGE_FSTYPES = "tar.gz ext4.gz ext4"
KERNEL_ARGS ?= "console=ttyTCU0,115200 fbcon=map:0 loglevel=3"
TEGRA_BOARDSKU ?= "0001"
TEGRA_BUPGEN_SPECS ?= "fab=100;boardsku=0001;boardrev= \
		       fab=301;boardsku=0001;boardrev="
IMAGE_ROOTFS_ALIGNMENT ?= "4"
INITRAMFS_IMAGE_BUNDLE = "0"
require conf/machine/include/xavier-nx.inc
EMMC_SIZE ?= "15758000128"
MACHINEOVERRIDES =. "jetson-xavier-nx-devkit-emmc:secureboot:cryptparts:"
PACKAGE_EXTRA_ARCHS:append = " jetson-xavier-nx-devkit-emmc"
PARTITION_LAYOUT_TEMPLATE = "flash_${MACHINE}_custom.xml"
ROOTFSPART_SIZE:jetson-xavier-nx-sb = "4294967296"
MACHINE_EXTRA_RDEPENDS += "tegra-boot-tools-lateboot lvm2-udevrules"
CORE_IMAGE_EXTRA_INSTALL:append = " ${@'systemd-conf-prod' if d.getVar('INIT_MANAGER') == 'systemd' else ''}"

MENDER_ROOTFS_PART_A_NUMBER:jetson-xavier-nx-sb = "APP"
MENDER_ROOTFS_PART_B_NUMBER:jetson-xavier-nx-sb = "APP_b"
MENDER_DATA_PART_NUMBER:jetson-xavier-nx-sb = "DATA"
MENDER_DATA_PART_SIZE_MB = "128"
MENDER_STORAGE_DEVICE_BASE = "/dev/mapper/"
# Reduce the rootfs size by 10% to allow for cryptfs overhead
MENDER_IMAGE_ROOTFS_SIZE_DEFAULT = "${@int(d.getVar('ROOTFSPART_SIZE')) * 9 // 10240}"
```
